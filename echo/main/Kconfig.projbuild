## echo/main/Kconfig.projbuild
```kconfig
menu "Application Configuration"

	choice MODEL
		prompt "Your module"
		default MODEL_SC16IS750
		help
			Select Hardware.
		config MODEL_SC16IS750
			bool "SC16IS750"
			help
				Your module is SC16IS750.
		config MODEL_SC16IS752
			bool "SC16IS752"
			help
				Your module is SC16IS752.
	endchoice

	config BAUDRATE1
		int "Communication speed of channel 1(bps)"
		default 115200
		help
			Communication speed of channel 1(bps).

	config AUTO_RS1
		bool "Enable Auto RS-485 RTS control for channel 1"
		default false
		help
			Enable Auto RS-485 RTS control for channel 1.

	config INVERT_RS1
		depends on AUTO_RS1
		bool "Enable RS-485 RTS output inversion for channel 1"
		default false
		help
			RS-485 RTS output inversion for channel 1.

	config BAUDRATE2
		depends on MODEL_SC16IS752
		int "Communication speed of channel 2(bps)"
		default 115200
		help
			Communication speed of channel 2(bps).

	config AUTO_RS2
		depends on MODEL_SC16IS752
		bool "Enable Auto RS-485 RTS control for channel 2"
		default false
		help
			Enable Auto RS-485 RTS control for channel 1.

	config INVERT_RS2
		depends on AUTO_RS2
		bool "Enable RS-485 RTS output inversion for channel 2"
		default false
		help
			RS-485 RTS output inversion for channel 2.


endmenu
```

## gpio/main/Kconfig.projbuild
```kconfig
menu "Application Configuration"

	config GPIO_RANGE_MAX
		int
		default 33 if IDF_TARGET_ESP32
		default 46 if IDF_TARGET_ESP32S2
		default 48 if IDF_TARGET_ESP32S3
		default 18 if IDF_TARGET_ESP32C2
		default 19 if IDF_TARGET_ESP32C3
		default 30 if IDF_TARGET_ESP32C6

	choice MODEL
		prompt "Your module"
		default MODEL_SC16IS750
		help
			Select Hardware.
		config MODEL_SC16IS750
			bool "SC16IS750"
			help
				Your module is SC16IS750.
		config MODEL_SC16IS752
			bool "SC16IS752"
			help
				Your module is SC16IS752.
	endchoice

	config SC16IS750_GPIO
		int "SC16IS75x GPIO number"
		range 0 7
		default 0
		help
			GPIO number of SC16IS750.

	choice DIRECTION
		prompt "Direction of GPIO"
		default GPIO_OUTPUT
		help
			Select direction of GPIO.
		config GPIO_OUTPUT
			bool "GPIO is OUTPUT"
			help
				GPIO is OUTPUT.
		config GPIO_INPUT
			bool "GPIO is INPUT using polling"
			help
				GPIO is INPUT using polling.
		config GPIO_INTERRUPT
			bool "GPIO is INPUT using interrupt"
			help
				GPIO is INPUT using interrupt.
	endchoice

	config IRQ_GPIO
		depends on GPIO_INTERRUPT
		int "IRQ GPIO number"
		range 0 GPIO_RANGE_MAX
		default 16 if IDF_TARGET_ESP32
		default 38 if IDF_TARGET_ESP32S2 || IDF_TARGET_ESP32S3
		default  7 # C3 and others
		help
			GPIO number (IOxx) to SPI SCLK.
			Some GPIOs are used for other purposes (flash connections, etc.) and cannot be used to DC.
			On the ESP32, GPIOs 35-39 are input-only so cannot be used as outputs.
			On the ESP32-S2, GPIO 46 is input-only so cannot be used as outputs.

endmenu
```

## receiver/main/Kconfig.projbuild
```kconfig
menu "Application Configuration"

	choice MODEL
		prompt "Your module"
		default MODEL_SC16IS750
		help
			Select Hardware.
		config MODEL_SC16IS750
			bool "SC16IS750"
			help
				Your module is SC16IS750.
		config MODEL_SC16IS752
			bool "SC16IS752"
			help
				Your module is SC16IS752.
	endchoice

	config BAUDRATE1
		int "Communication speed of channel 1(bps)"
		default 115200
		help
			Communication speed of channel 1(bps).

	config BAUDRATE2
		depends on MODEL_SC16IS752
		int "Communication speed of channel 2(bps)"
		default 115200
		help
			Communication speed of channel 2(bps).

	choice INPUT_END
		prompt "Terminator of input"
		default INPUT_END_CHARACTER
		help
			Select the end of the input.
		config INPUT_END_CHARACTER
			bool "Input ends with a specific character"
			help
				Input ends with a specific character.
		config INPUT_END_TIMEOUT
			bool "Input ends with a timeout"
			help
				Input ends with a timeout.
	endchoice

	config END_CHARACTER
		depends on INPUT_END_CHARACTER
		hex "Character at the end of input"
		range 0 127
		default 0xa
		help
			Character at the end of input.

	config END_TIMEOUT
		depends on INPUT_END_TIMEOUT
		int "Time-out millisecond at the end of input"
		default 500
		help
			Time-out millisecond at the end of input.

endmenu
```

## selftest/main/Kconfig.projbuild
```kconfig
menu "Application Configuration"

	choice MODEL
		prompt "Your module"
		default MODEL_SC16IS750
		help
			Select Hardware.
		config MODEL_SC16IS750
			bool "SC16IS750"
			help
				Your module is SC16IS750.
		config MODEL_SC16IS752
			bool "SC16IS752"
			help
				Your module is SC16IS752.
	endchoice

endmenu
```

## selftest/main/Kconfig.projbuild.old
```kconfig
menu "SC16IS752 Configuration"

	choice INTERFACE
		prompt "Interface"
		default I2C_INTERFACE
		help
			Select Interface.
		config I2C_INTERFACE
			bool "I2C Interface"
			help
				I2C Interface.
		config SPI_INTERFACE
			bool "SPI Interface"
			help
				SPI Interface.
	endchoice

	choice I2C_ADDRESS
		depends on I2C_INTERFACE
		prompt "I2C address"
		default I2C_ADDRESS_48
		help
			Select I2C address.
		config I2C_ADDRESS_48
			bool "I2C address is 0x48"
			help
				I2C address is 0x48
		config I2C_ADDRESS_49
			bool "I2C address is 0x49"
			help
				I2C address is 0x49
		config I2C_ADDRESS_4C
			bool "I2C address is 0x4C"
			help
				I2C address is 0x4C
		config I2C_ADDRESS_4D
			bool "I2C address is 0x4D"
			help
				I2C address is 0x4D
	endchoice

	config SCL_GPIO
		depends on I2C_INTERFACE
		int "SCL GPIO number"
		range 0 46
		default 22 if IDF_TARGET_ESP32
		default 12 if IDF_TARGET_ESP32S2
		default 9  if IDF_TARGET_ESP32C3
		help
			GPIO number (IOxx) to I2C SCL.
			Some GPIOs are used for other purposes (flash connections, etc.) and cannot be used to I2C.
			GPIOs 35-39 are input-only so cannot be used as outputs.

	config SDA_GPIO
		depends on I2C_INTERFACE
		int "SDA GPIO number"
		range 0 46
		default 21 if IDF_TARGET_ESP32
		default 11 if IDF_TARGET_ESP32S2
		default 10 if IDF_TARGET_ESP32C3
		help
			GPIO number (IOxx) to I2C SDA.
			Some GPIOs are used for other purposes (flash connections, etc.) and cannot be used to I2C.
			GPIOs 35-39 are input-only so cannot be used as outputs.

	config MISO_GPIO
		depends on SPI_INTERFACE
		int "MISO GPIO number"
		range 0 46
		default 19 if IDF_TARGET_ESP32
		default 33 if IDF_TARGET_ESP32S2
		default 0  if IDF_TARGET_ESP32C3
		help
			GPIO number (IOxx) to SPI MOSI.
			Some GPIOs are used for other purposes (flash connections, etc.) and cannot be used to DC.
			On the ESP32, GPIOs 35-39 are input-only so cannot be used as outputs.
			On the ESP32-S2, GPIO 46 is input-only so cannot be used as outputs.

	config MOSI_GPIO
		depends on SPI_INTERFACE
		int "MOSI GPIO number"
		range 0 46
		default 23 if IDF_TARGET_ESP32
		default 35 if IDF_TARGET_ESP32S2
		default 1  if IDF_TARGET_ESP32C3
		help
			GPIO number (IOxx) to SPI MOSI.
			Some GPIOs are used for other purposes (flash connections, etc.) and cannot be used to DC.
			On the ESP32, GPIOs 35-39 are input-only so cannot be used as outputs.
			On the ESP32-S2, GPIO 46 is input-only so cannot be used as outputs.

	config SCLK_GPIO
		depends on SPI_INTERFACE
		int "SCLK GPIO number"
		range 0 46
		default 18 if IDF_TARGET_ESP32
		default 36 if IDF_TARGET_ESP32S2
		default 2  if IDF_TARGET_ESP32C3
		help
			GPIO number (IOxx) to SPI SCLK.
			Some GPIOs are used for other purposes (flash connections, etc.) and cannot be used to DC.
			On the ESP32, GPIOs 35-39 are input-only so cannot be used as outputs.
			On the ESP32-S2, GPIO 46 is input-only so cannot be used as outputs.

endmenu
```
